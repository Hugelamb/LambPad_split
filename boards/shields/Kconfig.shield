## boards/shields/Kconfig.shield
```kconfig
# Created by Hugh Lam (2024)

config SHIELD_LAMBPAD_LEFT
    def_bool $(shields_list_contains, lambpad_left)
    
config SHIELD_LAMBPAD_RIGHT 
    def_bool $(shields_list_contains,lambpad_right)
```

## boards/shields/lambpad/Kconfig.defconfig
```kconfig
if SHIELD_LAMBPAD_LEFT

config ZMK_KEYBOARD_NAME
    default "lambpad"

config  ZMK_SPLIT_ROLE_CENTRAL
    default y

endif

if SHIELD_LAMBPAD_LEFT || SHIELD_LAMBPAD_RIGHT

config  ZMK_SPLIT
    default y

config ZMK_DISPLAY
    select LV_USE_CONT
    select LV_FONT_MONTSERRAT_26

choice ZMK_DISPLAY_STATUS_SCREEN
        default ZMK_DISPLAY_STATUS_SCREEN_CUSTOM

endchoice

if ZMK_DISPLAY

choice LV_FONT_DEFAULT
    default LV_FONT_DEFAULT_MONTSERRAT_26

endchoice

choice ZMK_LV_FONT_DEFAULT_SMALL
    default ZMK_LV_FONT_DEFAULT_SMALL_MONTSERRAT_26

endchoice

config SPI 
        default y

config LS0XX
        default y

config LV_Z_BITS_PER_PIXEL
        default 1

choice LV_COLOR_DEPTH
        default LV_COLOR_DEPTH_1

endchoice

config LV_DPI_DEF
	default 30

config LV_Z_VDB_SIZE
	default 16

endif # ZMK_DISPLAY

config ZMK_BLE
        default y

config ZMK_USB
        default y


endif
```
